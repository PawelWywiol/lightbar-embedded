## src/Kconfig.projbuild
```kconfig
menu "App Config"

  comment "Main Application configuration"

  menu "File System"

    config APP_FILE_SYSTEM_PARTITION_LABEL
      string "File System Partition Label"
      default "storage"
      help
        Label of the partition to be used for the file system.

  endmenu

  menu "Non-Volatile Storage"

    config APP_NVS_PARTITION_LABEL
      string "NVS Partition Label"
      default "nvs"
      help
        Label of the partition to be used for the NVS.

    config APP_NVS_NAMESPACE
      string "NVS Namespace"
      default "storage"
      help
        Namespace for the NVS.

    config APP_NVS_WIFI_CREDENTIALS_KEY
      string "NVS WiFi Credentials Key"
      default "app_wifi_cred"
      help
        Key for the NVS to store the WiFi credentials.

    config APP_NVS_AP_CREDENTIALS_KEY
      string "NVS AP Credentials Key"
      default "app_ap_cred"
      help
        Key for the NVS to store the AP credentials.

  endmenu

  menu "Network"

    config APP_AP_SSID_PREFIX
      string "AP SSID Prefix"
      default "lightbar"
      help
        Prefix for the AP SSID.

    config APP_AP_PASSWORD
      string "AP Password"
      default "lightbar"
      help
        Password for the AP.

    config APP_AP_CHANNEL
      int "AP Channel"
      default 1
      help
        Channel for the AP.

    config APP_AP_MAX_CONNECTIONS
      int "AP Max Connections"
      default 4
      help
        Maximum number of connections for the AP.

    config APP_DHCP_IP_START
      string "DHCP IP Start"
      default "1.2.3.4"
      help
        Start IP for DHCP.

    config APP_STA_MAXIMUM_RETRY
      int "STA Maximum Retry"
      default 5
      help
        Maximum number of retries for the STA.

    config APP_STA_CONNECT_TIMEOUT
      int "STA Connect Timeout"
      default 15
      help
        Timeout for the STA connection in seconds.

  endmenu

  menu "Lights"

    config APP_LIGHTS_COUNT
      int "Lights Count"
      range 1 720
      default 16
      help
        Number of lights.

    config APP_LIGHTS_GPIO
      int "Lights GPIO"
      default 10
      help
        GPIO for the lights.

    config APP_LIGHTS_POWER_GPIO
      int "Lights Power GPIO"
      default -1
      help
        GPIO driven high to enable power on the lights output (board relay), -1 if the board has none.

    config APP_LIGHTS_MAX_CURRENT_MA
      int "Lights Max Current (mA)"
      range 0 65000
      default 650
      help
        Estimated LED current limit; brightness of the whole frame is scaled down above it, 0 disables the limit.
        Set to the power source current minus the board's own current (USB: 1 A max through the board minus Wi-Fi TX peak).

    config APP_LIGHTS_LED_CURRENT_MA
      int "Lights LED Current (mA)"
      range 1 255
      default 55
      help
        Current of one LED at full white, used to estimate the frame current.

    choice APP_LIGHTS_COLOR_ORDER
      prompt "Lights Color Order"
      default APP_LIGHTS_COLOR_ORDER_GRB
      help
        Byte order of color channels expected by the LED chips.

      config APP_LIGHTS_COLOR_ORDER_GRB
        bool "GRB"

      config APP_LIGHTS_COLOR_ORDER_RGB
        bool "RGB"

    endchoice

  endmenu


endmenu
```
